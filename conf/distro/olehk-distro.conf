## conf/distro/olehk-distro.conf
```bitbake
require conf/distro/poky.conf

DISTRO_NAME = "OlehK Distro"
DISTRO_VERSION = "99.0.99"

SDK_VENDOR = "-olehksdkvendor"
SDK_VERSION = "olehksdkversion"

# Customize hostname
hostname_pn-base-files = "olehk-rpi"

# Replace sysvinit with systemd
DISTRO_FEATURES_append = " systemd"
VIRTUAL-RUNTIME_init_manager = "systemd"
DISTRO_FEATURES_remove += "sysvinit"
VIRTUAL-RUNTIME_initscripts = "systemd-compat-units"
DISTRO_FEATURES_BACKFILL_CONSIDERED += "sysvinit"
```

## conf/layer.conf
```bitbake
# We have a conf and classes directory, add to BBPATH
BBPATH .= ":${LAYERDIR}"

# We have recipes-* directories, add to BBFILES
BBFILES += "${LAYERDIR}/recipes-*/*/*.bb \
            ${LAYERDIR}/recipes-*/*/*.bbappend"

BBFILE_COLLECTIONS += "meta-olehk"
BBFILE_PATTERN_meta-olehk = "^${LAYERDIR}/"
BBFILE_PRIORITY_meta-olehk = "6"

LAYERDEPENDS_meta-olehk = "core"
LAYERSERIES_COMPAT_meta-olehk = "warrior zeus"
```

## conf/machine/raspberrypi3-olehk.conf
```bitbake
#@TYPE: Machine olehk
#@NAME: RaspberryPi 3 Development Board (32bit) olehk
#@DESCRIPTION: Machine configuration for the RaspberryPi 3 in 32 bits mode olehk

# Override raspberrypi3 olehk
MACHINEOVERRIDES =. "raspberrypi3:"

DEFAULTTUNE ?= "cortexa7thf-neon-vfpv4"
require conf/machine/include/tune-cortexa7.inc
include conf/machine/include/rpi-base.inc

MACHINE_EXTRA_RRECOMMENDS += "\
    linux-firmware-rpidistro-bcm43430 \
    linux-firmware-rpidistro-bcm43455 \
    bluez-firmware-rpidistro-bcm43430a1-hcd \
    bluez-firmware-rpidistro-bcm4345c0-hcd \
"

SDIMG_KERNELIMAGE ?= "kernel7.img"
UBOOT_MACHINE = "rpi_3_32b_config"
SERIAL_CONSOLES ?= "115200;ttyS0"

ARMSTUB ?= "armstub7.bin"

# Enable uart olehk
ENABLE_UART = "1"
# Enable i2c olehk
ENABLE_I2C = "1"
# Enable rpi-sdimg image build olehk
IMAGE_FSTYPES += "rpi-sdimg"

# Autoload i2c kernel module olehk
KERNEL_MODULE_AUTOLOAD += "i2c-dev"
```
